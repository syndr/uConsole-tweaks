## zmk-uc9900/config/boards/arm/bb9900/Kconfig
```kconfig
# Copyright (c) 2023 ZitaoTech
# SPDX-License-Identifier: MIT

config BOARD_ENABLE_DCDC
    bool "Enable DCDC mode"
    select SOC_DCDC_NRF52X
    default y
    depends on BOARD_BB9900

menu "uc9900 trackpad"
    depends on BOARD_BB9900

config INPUT_A320
    bool "Avago A320 optical sensor (I2C, polled)"
    default y
    depends on DT_HAS_AVAGO_A320_ENABLED
    depends on I2C && INPUT
    help
      Polls the ADBS-A320 finger-navigation sensor behind the trackpad and
      reports relative X/Y through Zephyr's input subsystem. The board has no
      motion-interrupt line, hence polling.

if INPUT_A320

config INPUT_A320_POLL_INTERVAL_MS
    int "Poll interval in milliseconds"
    range 1 50
    default 4
    help
      The vendor firmware polled every 2 ms. USB reports go out at most every
      millisecond, so shorter intervals only cost I2C traffic.

config INPUT_A320_INIT_PRIORITY
    int "Driver init priority"
    default 90

config INPUT_A320_OFN_ENGINE
    hex "Value written to the sensor's OFN_Engine register (0x60)"
    default 0x00
    help
      The sensor's finger-navigation features are off after power-up. 0xA0
      enables assert/de-assert (the sensor stops reporting as the finger
      lifts, which can stop the pointer jumping on lift-off) but was found to
      reject a bare finger on some trackpads. The register is written at
      every start, even when 0x00, because the sensor keeps whatever an
      earlier firmware wrote.

endif # INPUT_A320

config UC9900_SCROLL_LAYER
    int "Keymap layer that puts the trackpad into scroll mode"
    default 4
    help
      Must match the SCROLL layer number in bb9900.keymap. Used by the Caps
      Lock glue and the trackpad light.

config UC9900_CAPS_SCROLL
    bool "Host Caps Lock switches the trackpad into scroll mode"
    default y
    depends on ZMK_HID_INDICATORS
    help
      Activates the scroll layer while the host reports Caps Lock on, as the
      vendor firmware did, sharing direction and speed with hold-Select.

config UC9900_SCROLL_LIGHT
    bool "Trackpad light off while scroll mode is active"
    default y

config UC9900_TRACKPAD_LIGHT_IDLE_OFF
    bool "Trackpad light off while the keyboard is idle"
    default y
    help
      Off when ZMK's activity state leaves ACTIVE (after
      CONFIG_ZMK_IDLE_TIMEOUT without a key or trackpad touch), back on with
      the next key or touch.

config UC9900_HOST_SLEEP
    bool "Go dark and quiet while the host is asleep"
    default y
    depends on ZMK_HID_INDICATORS
    help
      The host signals sleep by setting a bit of the HID LED output report
      (the uConsole-sleep service uses Kana) and by suspending the USB link.
      While asleep: a layer of &none on top (no HID reports, no USB remote
      wakeup), trackpad polling stopped, backlight and trackpad light off.

if UC9900_HOST_SLEEP

config UC9900_HOST_SLEEP_LED_BIT
    int "HID LED report bit that means 'host asleep'"
    range 0 7
    default 4
    help
      0 Num Lock, 1 Caps Lock, 2 Scroll Lock, 3 Compose, 4 Kana.

config UC9900_HOST_SLEEP_LAYER
    int "Keymap layer activated while the host is asleep"
    default 6
    help
      Must match the HOSTSLEEP layer number in bb9900.keymap: every position
      &none, above all other layers.

endif # UC9900_HOST_SLEEP

endmenu
```

## zmk-uc9900/config/boards/arm/bb9900/bb9900_defconfig
```kconfig
# Copyright (c) 2023 ZitaoTech
# SPDX-License-Identifier: MIT

CONFIG_SOC_SERIES_NRF52X=y
CONFIG_SOC_NRF52840_QIAA=y
CONFIG_BOARD_BB9900=y

# Enable MPU
CONFIG_ARM_MPU=y

CONFIG_PINCTRL=y

# enable GPIO
CONFIG_GPIO=y

# Build Configuration
CONFIG_USE_DT_CODE_PARTITION=y
CONFIG_BUILD_OUTPUT_UF2=y

# Flash configuration
CONFIG_MPU_ALLOW_FLASH_WRITE=y
CONFIG_NVS=y
CONFIG_SETTINGS_NVS=y
CONFIG_FLASH=y
CONFIG_FLASH_PAGE_LAYOUT=y
CONFIG_FLASH_MAP=y

# Enable Signal Power Plus
CONFIG_BT_CTLR_TX_PWR_PLUS_8=y

# The board has no 32 kHz crystal: run the low-frequency clock from the RC
# oscillator (from the vendor config).
CONFIG_CLOCK_CONTROL_NRF=y
CONFIG_CLOCK_CONTROL_NRF_K32SRC_XTAL=n
CONFIG_CLOCK_CONTROL_NRF_K32SRC_RC=y

# Trackpad sensor on I2C0
CONFIG_I2C=y
```

## zmk-uc9900/config/boards/arm/bb9900/dts/bindings/behaviors/uconsole,behavior-scroll-dir-toggle.yaml
```yaml
# SPDX-License-Identifier: MIT

description: Toggle the trackpad scroll direction (natural / inverted) and remember it

compatible: "uconsole,behavior-scroll-dir-toggle"

include: zero_param.yaml
```

## zmk-uc9900/config/boards/arm/bb9900/dts/bindings/input/avago,a320.yaml
```yaml
# SPDX-License-Identifier: MIT

description: |
  Avago (Broadcom) ADBS-A320 optical finger navigation sensor on I2C, read by
  polling. Reports INPUT_REL_X / INPUT_REL_Y through the input subsystem.

compatible: "avago,a320"

include: i2c-device.yaml
```

## zmk-uc9900/config/boards/arm/bb9900/dts/bindings/input_processors/uconsole,input-processor-scroll-dir.yaml
```yaml
# SPDX-License-Identifier: MIT

description: |
  Negates wheel events (INPUT_REL_WHEEL / INPUT_REL_HWHEEL) when the scroll
  direction has been set to inverted with the scroll_dir_tog behavior. The
  setting is stored in Zephyr settings.

compatible: "uconsole,input-processor-scroll-dir"

include: ip_zero_param.yaml
```

## zmk-uc9900/config/west.yml
```yaml
manifest:
  remotes:
    - name: zmkfirmware
      url-base: https://github.com/zmkfirmware
  projects:
    - name: zmk
      remote: zmkfirmware
      revision: edf5c0814fd3ea202e43aad2d68fd32e882a518c # v0.3.0
      import: app/west.yml
  self:
    path: config
```
